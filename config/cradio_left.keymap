#include "cradio.keymap"

&kscan0 {
    input-gpios
        = <&gpio0 11 (GPIO_ACTIVE_LOW | GPIO_PULL_UP)> // Index 0  | Top Row, Pinky       (Left: Q / Right: J)
        , <&gpio1 15 (GPIO_ACTIVE_LOW | GPIO_PULL_UP)> // Index 1  | Top Row, Ring         (Left: W / Right: L)
        , <&gpio0 02 (GPIO_ACTIVE_LOW | GPIO_PULL_UP)> // Index 2  | Top Row, Middle       (Left: F / Right: U)
        , <&gpio0 29 (GPIO_ACTIVE_LOW | GPIO_PULL_UP)> // Index 3  | Top Row, Index        (Left: P / Right: Y)
        , <&gpio0 31 (GPIO_ACTIVE_LOW | GPIO_PULL_UP)> // Index 4  | Top Row, Inner Index  (Left: B / Right: SQT)

        , <&gpio1 13 (GPIO_ACTIVE_LOW | GPIO_PULL_UP)> // Index 5  | Home Row, Pinky       (Left: A / Right: M)
        , <&gpio1 11 (GPIO_ACTIVE_LOW | GPIO_PULL_UP)> // Index 6  | Home Row, Ring         (Left: R / Right: N)
        , <&gpio0 10 (GPIO_ACTIVE_LOW | GPIO_PULL_UP)> // Index 7  | Home Row, Middle       (Left: S / Right: E)
        , <&gpio1 1 (GPIO_ACTIVE_LOW | GPIO_PULL_UP)> // Index 8  | Home Row, Index        (Left: T / Right: I)
        , <&gpio1 7 (GPIO_ACTIVE_LOW | GPIO_PULL_UP)> // Index 9  | Home Row, Inner Index  (Left: G / Right: O)

        , <&gpio0 17 (GPIO_ACTIVE_LOW | GPIO_PULL_UP)> // Index 10 | Bottom Row, Pinky     (Left: Z / Right: K)
        , <&gpio0 20 (GPIO_ACTIVE_LOW | GPIO_PULL_UP)> // Index 11 | Bottom Row, Ring       (Left: X / Right: H)
        , <&gpio0 22 (GPIO_ACTIVE_LOW | GPIO_PULL_UP)> // Index 12 | Bottom Row, Middle     (Left: C / Right: ,)
        , <&gpio0 24 (GPIO_ACTIVE_LOW | GPIO_PULL_UP)> // Index 13 | Bottom Row, Index      (Left: D / Right: .)
        , <&gpio1 0 (GPIO_ACTIVE_LOW | GPIO_PULL_UP)> // Index 14 | Bottom Row, Inner Index(Left: V / Right: /)

        , <&gpio1 4 (GPIO_ACTIVE_LOW | GPIO_PULL_UP)> // Index 15 | Thumb Key, Outer       (Left: Num   / Right: Shift)
        , <&gpio1 6 (GPIO_ACTIVE_LOW | GPIO_PULL_UP)> // Index 16 | Thumb Key, Inner       (Left: Space / Right: Sym)
        ;
};
