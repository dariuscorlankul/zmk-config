
#include <dt-bindings/gpio/gpio.h>

/ {
    // Target the existing default matrix by its path (no labels needed).
    // This keeps its links alive so the physical layout doesn't crash!
    kscan {
        compatible = "zmk,kscan-gpio-direct";
        
        // Nuke the default Cradio matrix properties so they don't cause ghosting or conflicts
        /delete-property/ row-gpios;
        /delete-property/ col-gpios;
        /delete-property/ diode-direction;
        
        input-gpios
            = <&gpio0 11 (GPIO_ACTIVE_LOW | GPIO_PULL_UP)> // Index 0  | Top Row, Pinky       (Right: J)
            , <&gpio1 15 (GPIO_ACTIVE_LOW | GPIO_PULL_UP)> // Index 1  | Top Row, Ring         (Right: L)
            , <&gpio0 2 (GPIO_ACTIVE_LOW | GPIO_PULL_UP)>  // Index 2  | Top Row, Middle       (Right: U)
            , <&gpio0 29 (GPIO_ACTIVE_LOW | GPIO_PULL_UP)> // Index 3  | Top Row, Index        (Right: Y)
            , <&gpio0 31 (GPIO_ACTIVE_LOW | GPIO_PULL_UP)> // Index 4  | Top Row, Inner Index  (Right: SQT)

            , <&gpio1 2 (GPIO_ACTIVE_LOW | GPIO_PULL_UP)>  // Index 5  | Home Row, Pinky       (Right: M)
            , <&gpio1 11 (GPIO_ACTIVE_LOW | GPIO_PULL_UP)> // Index 6  | Home Row, Ring         (Right: N)
            , <&gpio0 10 (GPIO_ACTIVE_LOW | GPIO_PULL_UP)> // Index 7  | Home Row, Middle       (Right: E)
            , <&gpio1 1 (GPIO_ACTIVE_LOW | GPIO_PULL_UP)>  // Index 8  | Home Row, Index        (Right: I)
            , <&gpio1 7 (GPIO_ACTIVE_LOW | GPIO_PULL_UP)>  // Index 9  | Home Row, Inner Index  (Right: O)

            , <&gpio0 17 (GPIO_ACTIVE_LOW | GPIO_PULL_UP)> // Index 10 | Bottom Row, Pinky     (Right: K)
            , <&gpio0 20 (GPIO_ACTIVE_LOW | GPIO_PULL_UP)> // Index 11 | Bottom Row, Ring       (Right: H)
            , <&gpio0 22 (GPIO_ACTIVE_LOW | GPIO_PULL_UP)> // Index 12 | Bottom Row, Middle     (Right: ,)
            , <&gpio0 24 (GPIO_ACTIVE_LOW | GPIO_PULL_UP)> // Index 13 | Bottom Row, Index      (Right: .)
            , <&gpio1 0 (GPIO_ACTIVE_LOW | GPIO_PULL_UP)>  // Index 14 | Bottom Row, Inner Index(Right: /)

            , <&gpio1 4 (GPIO_ACTIVE_LOW | GPIO_PULL_UP)>  // Index 15 | Thumb Key, Outer       (Right: Shift)
            , <&gpio1 6 (GPIO_ACTIVE_LOW | GPIO_PULL_UP)>  // Index 16 | Thumb Key, Inner       (Right: Sym)
            ;
    };
};;;

